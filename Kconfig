## Kconfig
```kconfig
#
# Copyright (c) 2022 Dhruva Gole
#
# SPDX-License-Identifier: Apache-2.0
#

config ARDUINO_API
	bool "ARDUINO_API"
	imply CPLUSPLUS
	imply ADC
	imply GPIO
	imply I2C
	imply SPI
	imply NEWLIB_LIBC_FLOAT_PRINTF
	imply CBPRINTF_FP_SUPPORT
	imply RING_BUFFER
	select UART_INTERRUPT_DRIVEN
	default n

if ARDUINO_API

config ARDUINO_API_SERIAL_BUFFER_SIZE
	int "Buffer size for Arduino Serial API"
	default 64

endif
```
